## conf/layer.conf
```bitbake
# We have a conf and classes directory, add to BBPATH
BBPATH .= ":${LAYERDIR}"

# We have a packages directory, add to BBFILES
BBFILES += "${LAYERDIR}/recipes-sema/sema/sema_4.0.bb"  # Build only BMC drivers, and not EC drivers

BBFILE_COLLECTIONS += "meta-adlink-sema"
BBFILE_PATTERN_meta-adlink-sema := "^${LAYERDIR}/"
BBFILE_PRIORITY_meta-adink-sema = "10"
LAYERVERSION_meta-adlink-sema = "1"

LAYERSERIES_COMPAT_meta-adlink-sema = "nanbield sumo thud zeus dunfell hardknott kirkstone"
```
